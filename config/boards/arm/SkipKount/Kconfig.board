## config/boards/arm/SkipKount/Kconfig.board
```kconfig
# SkipKount board configuration

# Copyright (c) 2023 Spanky
# SPDX-License-Identifier: MIT

config BOARD_SKIPKOUNT
        bool "SkipKount"
        depends on SOC_NRF52840_QIAA
```

## config/boards/arm/SkipKount/Kconfig.defconfig
```kconfig
if BOARD_SKIPKOUNT

config BOARD
        default "SkipKount"

config ZMK_KEYBOARD_NAME
        default "SkipKount"

if USB

config USB_NRFX
        default y

config USB_DEVICE_STACK
        default y

endif # USB

config BT_CTLR
        default BT

config ZMK_BLE
        default y

config ZMK_USB
        default y

config ZMK_BATTERY_VOLTAGE_DIVIDER
        default y

endif # BOARD_SKIPKOUNT    
```

## config/boards/shields/SkipKount/Kconfig.defconfig
```kconfig
if SHIELD_SKIPKOUNT

config SHIELD
        default "SkipKount"

config ZMK_KEYBOARD_NAME
        default "SkipKount"

if USB

config USB_NRFX
        default y

config USB_DEVICE_STACK
        default y

endif # USB

config BT_CTLR
        default BT

config ZMK_BLE
        default y

config ZMK_USB
        default y

config ZMK_BATTERY_VOLTAGE_DIVIDER
        default y

endif # SHIELD_SKIPKOUNT    
```
