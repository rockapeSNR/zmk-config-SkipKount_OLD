/*
* Copyright (c) 2023 Spanky
*
* SPDX-License-Identifier: MIT
*/

/dts-v1/;
#include <nordic/nrf52840_qiaa.dtsi>
#include <dt-bindings/zmk/gpio-direct.h>

/ {
    model = "SkipKount";
    compatible = "spanky,skipkount";

    chosen {
        zmk,kscan = &default_kscan;
    };

    default_kscan: kscan {
        compatible = "zmk,kscan-gpio-direct";
        label = "default_kscan";
        debounce-press-ms = <1>;
        debounce-release-ms = <5>;

        input-gpios 
                  = <&xiao_d 0 (GPIO_ACTIVE_LOW | GPIO_PULL_UP)>
                  , <&xiao_d 1 (GPIO_ACTIVE_LOW | GPIO_PULL_UP)>
                  , <&xiao_d 2 (GPIO_ACTIVE_LOW | GPIO_PULL_UP)>
                  , <&xiao_d 3 (GPIO_ACTIVE_LOW | GPIO_PULL_UP)>
                  , <&xiao_d 4 (GPIO_ACTIVE_LOW | GPIO_PULL_UP)>
                  ;
    };
};