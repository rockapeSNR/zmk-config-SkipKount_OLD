#include <behaviors.dtsi>
#include <dt-bindings/zmk/keys.h>
#include <dt-bindings/zmk/bt.h>

/ {
    keymap {
        compatible = "zmk,keymap";

        default_layer {
            bindings = <
                &kp A
                &kp B
                &kp C
                &kp D
                &mo 1
            >;
        };

        bt_layer {
            bindings = <
                &bt BT_CLR
                &bt BT_SEL 0
                &bt BT_SEL 1
                &bt BT_SEL 2
            >;
        };
    };
};